/* ===========================================================================
 * CytonWiFiBridge
 *
 * Seeed XIAO ESP32C3 acting as the wireless link for an OpenBCI Cyton whose
 * RFD22301 radio (BLE1) was never populated.
 *
 *      Cyton  <--UART 115200-->  XIAO ESP32C3  <--WiFi TCP-->  PC
 *
 * ---------------------------------------------------------------------------
 * WIRING - 3.3V both sides, no level shifting required
 * ---------------------------------------------------------------------------
 *   Cyton D11  (J4 pin 4)   ->  XIAO D1 / GPIO3     Cyton transmits
 *   Cyton D12  (J3 pin 2)   <-  XIAO D2 / GPIO4     Cyton receives
 *   Cyton AGND (J3 pin 4)   <-> XIAO GND            required
 *
 * A USB-TTL adapter may share D11 (its RX only) as an independent monitor.
 * Two receivers on one transmit line is fine. Never put two transmitters on
 * D12 - only the XIAO drives that pin.
 *
 * ---------------------------------------------------------------------------
 * WHY D11/D12 AND NOT THE "RFTX"/"RFRX" PADS
 * ---------------------------------------------------------------------------
 * The pads silkscreened RFTX / RFRX / RFRESET are a breakout for the RFduino
 * module's OWN serial port (module GPIO0/GPIO1), provided so you can flash the
 * radio. They never connect to the PIC32. With BLE1 unpopulated they are dead
 * traces, and a UART attached to them decodes ambient noise into ~225 junk
 * bytes/sec.
 *
 * The PIC's Serial0 reaches only BLE1 pins 3/4, which are unreachable module
 * pads. But firmware built with board.beginDebug() mirrors every outgoing byte
 * to Serial1 as well - including the streaming EEG data - and processes
 * incoming commands from Serial1. Serial1 is D11/D12, on the accessible J3/J4
 * headers. So the debug port is a fully bidirectional substitute.
 *
 * REQUIRES Cyton firmware built with board.beginDebug() (not board.begin()).
 *
 * ---------------------------------------------------------------------------
 * ARDUINO IDE SETTINGS
 * ---------------------------------------------------------------------------
 *   Board:            XIAO_ESP32C3
 *   USB CDC On Boot:  ENABLED        <-- required
 *
 * With CDC disabled, `Serial` falls back to UART0 on GPIO20/21 (silkscreen
 * D6/D7) and collides with anything else placed there. GPIO2, GPIO8 and GPIO9
 * are strapping pins and are avoided.
 *
 * Close the Serial Monitor before every upload - the ESP32C3's USB port is
 * generated by the chip itself and re-enumerates on reset, so a monitor
 * holding the old handle blocks the upload.
 *
 * ---------------------------------------------------------------------------
 * NETWORK MODES  (set USE_SOFTAP below)
 * ---------------------------------------------------------------------------
 * USE_SOFTAP 1 - ACCESS POINT (default, recommended for a portable rig)
 *   The XIAO creates its own WiFi network. Your laptop joins it directly, so
 *   there is no router in the path: same address every boot, strongest
 *   possible signal, lowest latency, and it works in a clinic or lab with no
 *   WiFi at all. Cost: the laptop has no internet while connected.
 *
 *     join SSID "CytonBridge" / pass "neurorehab", then connect to
 *     192.168.4.1:3000
 *
 * USE_SOFTAP 0 - STATION
 *   The XIAO joins an existing network and gets an address from DHCP (or a
 *   fixed one via USE_STATIC_IP). Convenient at a desk, but signal strength
 *   is whatever the room gives you - below about -80 dBm this link starts
 *   losing samples, and at 8250 B/s that shows up as gaps in the EEG.
 *
 * ---------------------------------------------------------------------------
 * COMMANDS  (type into Serial Monitor, or send over the TCP socket)
 * ---------------------------------------------------------------------------
 *   b  start streaming EEG        s  stop streaming
 *   v  soft reset (re-sends the boot banner)
 *   ?  dump register settings
 *
 * Test signals - useful before you own electrodes. With open inputs every
 * channel rails at 0x800000; these drive known waveforms through the ADS1299
 * so you can prove the analog front end works:
 *   0  connect all channels to ground (measures noise floor)
 *   -  1x amplitude square wave, slow      =  1x fast
 *   [  2x amplitude square wave, slow      ]  2x fast
 *   p  connect to DC
 *
 * Healthy stream: 33 bytes x 250 Hz = ~8250 B/s and ~250 packets/sec.
 * =========================================================================== */

#include <WiFi.h>

// ---------------------------------------------------------------- settings --

// 1 = ACCESS POINT. The XIAO creates its own network and your laptop joins it
//     directly. No router involved: fixed address every time, best signal,
//     works anywhere. Your laptop loses internet while connected.
// 0 = STATION. The XIAO joins your existing WiFi.
#define USE_SOFTAP 1

// -- access point mode (USE_SOFTAP 1) --
const char *AP_SSID    = "CytonBridge";
const char *AP_PASS    = "neurorehab";     // must be >= 8 chars for WPA2
const uint8_t AP_CHAN  = 6;                // 1, 6 or 11 are non-overlapping
// The bridge is always at 192.168.4.1 in this mode.

// -- station mode (USE_SOFTAP 0) --
const char *WIFI_SSID  = "Abhijith-2.4";
const char *WIFI_PASS  = "YOUR_WIFI_PASSWORD";

// Optional fixed address in station mode, so the bridge lands on the same IP
// every boot. Pick something above your router's DHCP pool.
// #define USE_STATIC_IP
#ifdef USE_STATIC_IP
static IPAddress STATIC_IP (192, 168, 1, 200);
static IPAddress GATEWAY   (192, 168, 1, 1);
static IPAddress SUBNET    (255, 255, 255, 0);
static IPAddress DNS_SRV   (192, 168, 1, 1);
#endif

const uint16_t TCP_PORT = 3000;

#define CYTON_RX_PIN 3        // XIAO D1 <- Cyton D11
#define CYTON_TX_PIN 4        // XIAO D2 -> Cyton D12
#define CYTON_BAUD   115200

#define SHOW_PREVIEW 1        // 1 = print a hex/ASCII sample each second
// -----------------------------------------------------------------------------

WiFiServer server(TCP_PORT);
WiFiClient client;

static uint8_t  buf[1024];
static uint32_t rxBytes  = 0;      // bytes this second
static uint32_t lastTick = 0;

// OpenBCI packet framing, confirmed against library v3.1.5:
//   writeSerial(OPENBCI_BOP)                 -> 0x41 ('A'), NOT the 0xA0 the
//                                               older OpenBCI docs describe
//   sample counter                           -> 1 byte
//   8 channels x 3 bytes                     -> 24 bytes
//   aux                                      -> 6 bytes
//   writeSerial(PCKT_END | packetType)       -> 0xC0..0xCF
//                                            = 33 bytes total
// Tracking this turns "some bytes arrived" into a real integrity measure.
#define OPENBCI_START_BYTE 0x41

static int      pktPos  = -1;      // -1 = hunting for the start byte
static uint32_t pktGood = 0;
static uint32_t pktBad  = 0;

#if SHOW_PREVIEW
static uint8_t preview[24];
static int     previewLen = 0;
#endif

// -----------------------------------------------------------------------------

static void trackPacket(uint8_t b) {
  if (pktPos < 0) {
    if (b == OPENBCI_START_BYTE) pktPos = 0;   // possible start of packet
  } else {
    pktPos++;
    if (pktPos == 32) {                  // 33rd byte is the stop byte
      if ((b & 0xF0) == 0xC0) pktGood++; else pktBad++;
      pktPos = -1;
    }
  }
}

static void startNetwork() {
#if USE_SOFTAP
  WiFi.mode(WIFI_AP);
  WiFi.setSleep(false);                  // keep latency low for realtime use

  if (!WiFi.softAP(AP_SSID, AP_PASS, AP_CHAN)) {
    Serial.println("ERROR: could not start access point");
    return;
  }
  Serial.println("Access point up. On your laptop, join:");
  Serial.printf ("  SSID:     %s\n", AP_SSID);
  Serial.printf ("  Password: %s\n", AP_PASS);
  Serial.print  ("  Bridge:   ");
  Serial.print  (WiFi.softAPIP());       // always 192.168.4.1
  Serial.printf (":%u\n", TCP_PORT);
  Serial.printf ("  Channel:  %u\n", AP_CHAN);
#else
#ifdef USE_STATIC_IP
  if (!WiFi.config(STATIC_IP, GATEWAY, SUBNET, DNS_SRV)) {
    Serial.println("WARNING: static IP config failed, falling back to DHCP");
  }
#endif
  WiFi.mode(WIFI_STA);
  WiFi.setSleep(false);
  WiFi.begin(WIFI_SSID, WIFI_PASS);

  Serial.printf("Joining \"%s\"", WIFI_SSID);
  while (WiFi.status() != WL_CONNECTED) {
    delay(250);
    Serial.print(".");
  }
  Serial.println();
  Serial.print  ("  IP:   ");
  Serial.print  (WiFi.localIP());
  Serial.printf (":%u\n", TCP_PORT);
  Serial.printf ("  RSSI: %d dBm   (weaker than -80 will drop samples)\n",
                 WiFi.RSSI());
#endif
}

static void printReport() {
  Serial.printf("[%5lu B/s | %3lu pkt/s", (unsigned long)rxBytes,
                (unsigned long)pktGood);
  if (pktBad) Serial.printf(" | %lu BAD", (unsigned long)pktBad);
  Serial.print(client && client.connected() ? " | client] " : " | no client] ");

#if SHOW_PREVIEW
  for (int i = 0; i < previewLen; i++) Serial.printf("%02X ", preview[i]);
  Serial.print("|");
  for (int i = 0; i < previewLen; i++) {
    char c = (char)preview[i];
    Serial.print((c >= 32 && c < 127) ? c : '.');
  }
  Serial.print("|");
#endif
  Serial.println();
}

// -----------------------------------------------------------------------------

void setup() {
  Serial.begin(115200);                  // USB CDC console
  delay(300);

  // Enlarge the UART receive buffer BEFORE begin(). The 256-byte default is
  // only ~31 ms of headroom at 8250 B/s.
  Serial1.setRxBufferSize(4096);
  Serial1.begin(CYTON_BAUD, SERIAL_8N1, CYTON_RX_PIN, CYTON_TX_PIN);

  Serial.println("\n=== CytonWiFiBridge ===");
  Serial.printf("UART  RX=GPIO%d (<-Cyton D11)  TX=GPIO%d (->Cyton D12)  @%d\n",
                CYTON_RX_PIN, CYTON_TX_PIN, CYTON_BAUD);

  startNetwork();

  server.begin();
  server.setNoDelay(true);               // no Nagle buffering on a realtime link

  Serial.println("Ready. Commands: b=stream  s=stop  v=reset  ?=registers");
  Serial.println("Waiting for a TCP client...");
}

void loop() {
  // -- accept a client, notice when one leaves --------------------------------
  if (!client || !client.connected()) {
    if (client) {
      client.stop();
      Serial.println("Client disconnected.");
    }
    WiFiClient incoming = server.available();
    if (incoming) {
      client = incoming;
      client.setNoDelay(true);
      Serial.print("Client connected: ");
      Serial.println(client.remoteIP());
    }
  }

  // -- Cyton -> network -------------------------------------------------------
  int avail = Serial1.available();
  if (avail > 0) {
    if (avail > (int)sizeof(buf)) avail = sizeof(buf);
    int got = Serial1.readBytes(buf, avail);
    rxBytes += got;

    for (int i = 0; i < got; i++) {
      trackPacket(buf[i]);
#if SHOW_PREVIEW
      if (previewLen < (int)sizeof(preview)) preview[previewLen++] = buf[i];
#endif
    }

    if (client && client.connected()) client.write(buf, got);
  }

  // -- network -> Cyton -------------------------------------------------------
  if (client && client.connected()) {
    while (client.available()) Serial1.write((uint8_t)client.read());
  }

  // -- USB console -> Cyton (type commands by hand) ---------------------------
  while (Serial.available()) Serial1.write((uint8_t)Serial.read());

  // -- once-per-second status -------------------------------------------------
  uint32_t now = millis();
  if (now - lastTick >= 1000) {
    if (rxBytes > 0) printReport();
    rxBytes = 0;
    pktGood = 0;
    pktBad  = 0;
#if SHOW_PREVIEW
    previewLen = 0;
#endif
    lastTick = now;
  }
}
